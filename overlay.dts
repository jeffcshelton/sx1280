/dts-v1/;
/plugin/;

/ {
  fragment@0 {
    target = <&spi0>;

    __overlay__ {
      status = "okay";

      sx@0 {
        compatible = "semtech,sx1280";
        reg = <0>;

        busy-gpios = <&gpio 17 GPIO_ACTIVE_HIGH>;
        dio-gpios = <&gpio 22 GPIO_ACTIVE_HIGH, -1, -1>;
      };
    };
  };
};
